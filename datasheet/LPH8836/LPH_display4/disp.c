/* ***********************************************************************
**
**  Copyright (C) 2005  Christian Kranz
**
**  Siemens S65 Display Control for LPH* type displayd
**  Hitachi HD66766 compatible
*********************************************************************** */
// file disp.c
//

// my includes
#include <avr/delay.h>
#include "disp.h"

#define LCD_CS	   PB0
#define LCD_RESET  PB6
#define LCD_RS	   PB7
#define LCD_MOSI   PB2
#define LCD_MISO   PB3
#define LCD_SCK    PB1


// ascii table, starting with character blank (32)
// size is 8x14
uint8_t ascii_tab[96][14]={
{ 0x00, 0x00, 0x00, 0x00, 0x00, 0x00, 0x00, 0x00, 0x00, 0x00, 0x00, 0x00, 0x00, 0x00}, // space (32)
{ 0x00, 0x00, 0x00, 0x18, 0x3c, 0x3c, 0x3c, 0x18, 0x18, 0x00, 0x18, 0x18, 0x00, 0x00}, //!
{ 0x00, 0x66, 0x66, 0x66, 0x24, 0x00, 0x00, 0x00, 0x00, 0x00, 0x00, 0x00, 0x00, 0x00}, //"
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{ 0x00, 0x00, 0x00, 0x00, 0x00, 0x10, 0x38, 0x6c, 0xc6, 0xc6, 0xfe, 0x00, 0x00, 0x00},
};

uint16_t backcolor=0xFFFF;    // color of background
uint16_t textcolor=0x0000;


void port_init()
{
  uint8_t tmp;
  
  PORTB &= ~_BV(LCD_RESET);
  DDRB |= _BV(LCD_RESET);

  PORTB |= _BV(LCD_MOSI);
  DDRB |= _BV(LCD_MOSI);
  
  PORTB &= ~_BV(LCD_CS);
  DDRB |= _BV(LCD_CS);
  
  PORTB &= ~_BV(LCD_SCK);
  DDRB |= _BV(LCD_SCK);
  
  PORTB |= _BV(LCD_MISO);

  PORTB |= _BV(LCD_RS);  // not used from LPH display
  DDRB |= _BV(LCD_RS);
  
  // setup SPI Interface
  SPCR = _BV(MSTR) | _BV(SPE) | _BV(SPR0);
  SPSR = 1;  // double speed bit

  tmp=SPSR;
}

void lcd_write(uint8_t dat)
{
  SPDR= dat;
  while (!(SPSR & _BV(SPIF)));
}

void lcd_cspulse(void)
{
  PORTB |= _BV(LCD_CS);
  asm volatile("nop");
  PORTB &= ~_BV(LCD_CS);
}


void lcd_comtype(uint8_t dat1)
{
  lcd_write(0x74);  // indicates command type
  lcd_write(0x00);
  lcd_write(dat1);
  lcd_cspulse();
}

void lcd_comdat(uint8_t dat1, uint8_t dat2)
{
  lcd_write(0x76);  // indicates command data
  lcd_write(dat1);
  lcd_write(dat2);
  lcd_cspulse();
}

void lcd_write16(uint16_t dat)
{
  lcd_write(dat>>8);
  lcd_write(dat);
}


void lcd_init_c(void)
/*
  Initialization of the LPH-Type display. Note that this display does not need the RS line.
  Instead it uses command type indication and command data indication.
  
  (c) Christian Kranz, 10/2005
*/
{
  uint8_t ct1[6]={0x07,0x02,0x04,0x0C,0x0D,0x0E};
  uint8_t cd1[12]={0x00,0x00, 0x04,0x00, 0x00,0x00, 0x00,0x01, 0x06,0x16, 0x10,0x10};
  uint8_t ct2[2]={0x03,0x0E};
  uint8_t cd2[4]={0x00,0x0C, 0x2D,0x1F};
  uint8_t ct3[1]={0x0D};
  uint8_t cd3[2]={0x06,0x16};
  uint8_t ct4[21]={0x01,0x0F,0x0B,0x11,0x06,0x05,0x14,0x15,0x16,0x17,0x20,0x30,0x31,0x32,0x33,0x34,0x35,0x36,0x37,0x3A,0x3B};
  uint8_t cd4[42]={0x02,0x15, 0x00,0x00, 0x00,0x00, 0x00,0x00, 0x00,0x00, 0x00,0x30, 0xAF,0x00, 0x00,0x00, 0x83,0x00, 0xAF,0x00,
        0x00,0x00, 0x00,0x00, 0x04,0x00, 0x02,0x07, 0x07,0x00, 0x00,0x05, 0x07,0x03, 0x07,0x07, 0x00, 0x07, 0x12,0x00, 0x00,0x09};

  uint8_t i,j;

  // generate clean display reset
  PORTB &= ~_BV(LCD_RESET); // reset display
  PORTB |= _BV(LCD_CS);  // CS is high during reset release
  PORTB |= _BV(LCD_RS);  // RS is not used, set it to high
  _delay_ms(1);
  PORTB |= _BV(LCD_RESET);  // release reset
  _delay_ms(10);

  PORTB &= ~_BV(LCD_CS);  // select display

// starts at 58.8ms
  lcd_comtype(0x00);
  lcd_comdat(0x00,0x01);
// starts at 125ms
  j=0;
  for (i=0; i<6; i++)
  {
    lcd_comtype(ct1[i]);
    lcd_comdat(cd1[j++],cd1[j++]);
  }
// start at 240ms
  j=0;
  for (i=0; i<2; i++)
  {
    lcd_comtype(ct2[i]);
    lcd_comdat(cd2[j++],cd2[j++]);
  }
// start at 355ms
  j=0;
  for (i=0; i<1; i++)
  {
    lcd_comtype(ct3[i]);
    lcd_comdat(cd3[j++],cd3[j++]);
  }
// start at 458ms
  j=0;
  for (i=0; i<21; i++)
  {
    lcd_comtype(ct4[i]);
    lcd_comdat(cd4[j++],cd4[j++]);
  }
  lcd_comtype(0x07);
  lcd_comdat(0x00, 0x05);
  lcd_comtype(0x07);
  lcd_comdat(0x00, 0x25);
  lcd_comtype(0x07);
  lcd_comdat(0x00, 0x27);
  lcd_comtype(0x07);
  lcd_comdat(0x00, 0x37);
// ready for first screen
  PORTB |= _BV(LCD_CS);  // deselect display 
}


void fill_screen(uint16_t color)
{
  uint16_t i;

  PORTB &= ~_BV(LCD_CS);  // select display
  
  lcd_comtype(0x16);
  lcd_comdat(0x83, 0x00);
  lcd_comtype(0x17);
  lcd_comdat(0xAF, 0x00);
  lcd_comtype(0x21);
  lcd_comdat(0x00, 0x00);
  lcd_comtype(0x22);
  lcd_write(0x76);  
  
  // start data transmission  
  for (i=0; i<DISP_W*DISP_H; i++)
    lcd_write16(color);
    
  PORTB |= _BV(LCD_CS);  // deselect display    
}


void put_char(uint8_t x, uint8_t y, char c, uint8_t rot)
{
  uint8_t h,ch,p,mask;

  PORTB &= ~_BV(LCD_CS);  // select display
  
  switch(rot)
  {
    default:
    case 0:
      lcd_comtype(0x05);
      lcd_comdat(0x00,0x38);
      lcd_comtype(0x17);
      lcd_comdat(x+CHAR_W-1, x);
      lcd_comtype(0x16);
      lcd_comdat(y+CHAR_H-1, y);
      lcd_comtype(0x21);
      lcd_comdat(x,y);
      lcd_comtype(0x22);
      lcd_write(0x76);  
      break;
    case 1:
      lcd_comtype(0x05);
      lcd_comdat(0x00,0x30);
      lcd_comtype(0x16);
      lcd_comdat(x+CHAR_W-1, x);
      lcd_comtype(0x17);
      lcd_comdat(y+CHAR_H-1, y);
      lcd_comtype(0x21);
      lcd_comdat(y, x);
      lcd_comtype(0x22);
      lcd_write(0x76);  
      break;
  }

  
  for (h=0; h<CHAR_H; h++) // every column of the character
  {        
       if (rot==1)
          ch=ascii_tab[ c-32 ][h];	
	else
          ch=ascii_tab[ c-32 ][CHAR_H-h-1];
	
        mask=0x80;
        for (p=0; p<CHAR_W; p++)  // write the pixels
        {
          if (ch&mask)
          {
            lcd_write16(textcolor);                
          }
          else
          {
            lcd_write16(backcolor);
          }
          mask=mask/2;
        }  // for p
  }
  PORTB |= _BV(LCD_CS);  // deselect display    

}



// end of file
